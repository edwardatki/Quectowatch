## V2/Firmware/boards/arm/quectowatch/Kconfig.defconfig
```kconfig
# Copyright (c) 2024 Nordic Semiconductor ASA
# SPDX-License-Identifier: Apache-2.0

if BOARD_QUECTOWATCH

config BOARD
	default "quectowatch"

config BT_CTLR
   default BT

if USB

config USB_NRFX
	def_bool y

config USB_DEVICE_STACK
	def_bool y

endif

endif
```

## V2/Firmware/boards/arm/quectowatch/quectowatch_defconfig
```kconfig
# Copyright (c) 2024 Nordic Semiconductor ASA
# SPDX-License-Identifier: Apache-2.0

CONFIG_SOC_SERIES_NRF52X=y
CONFIG_SOC_NRF52840_QIAA=y
CONFIG_BOARD_QUECTOWATCH=y

# Enable MPU
CONFIG_ARM_MPU=y

# Enable hardware stack protection
CONFIG_HW_STACK_PROTECTION=y

CONFIG_GPIO=y

# Build UF2
CONFIG_BUILD_OUTPUT_UF2=y
CONFIG_ROM_START_OFFSET=0x1000
```
